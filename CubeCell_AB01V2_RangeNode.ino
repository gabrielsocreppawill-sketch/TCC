/*
20:28:00.491 -> 
ID=000093A3A6A73333;
BN=CubeCell_AB01_V2;
C=3;L=201.67;T=23.07;P
=1018.42;U=66.00;
B=3746;
LA=0.000000;LO=0.000000;
GD=;GT=;GA=0.00;GS=0;TX=14


Sinal bom:                          1 piscada curta a cada 5 s
Sinal baixo:                        pisca a cada 500 ms
Sinal crítico:                      pisca a cada 150 ms
Potência aumentada pelo Gateway:    3 piscadas rápidas
*/

/* - - - - - - - - - - - - - - - - - - - - - - - - - - - - - - - - - - - - - - - */
/* - - - - - - - - - - DEVICE - BOARD SETTINGS - CONFIGURTATIONS - - - - - - - - */
/* - - - - - - - - LORA HELTEC CUBECELL (HTCC-AB01) - BRAZIL - AU915-928 - - - - */
/* - - - - - - ASR6501 - CubeCell-Board, CubeCell-Module, CubeCell-Capsule - - - */
/*              CARTE                           CUBECELL BOARD (HTCC-AB01) V1 & V2
 *              CUBECELL (HTCC-AB01)            LIBRARY - V.1.5.0
 *              LORAWAN_ADR :                   ON
 *              LORAWAN_AT_SUPPORT :            OFF
 *              LORAWAN_CLASS :                 CLASS_A
 *              LORAWAN DEBUG LEVEL :           RIEN
 *              LORAWAN_DEVEUI :                GENERATED BY CHIP ID
 *              LORAWAN_NET_RESERVATION :       OFF
 *              LORAWAN_NETMODE :               ABP
 *              LORAWAN_PREAMBLE_LENGTH :       8 (DEFAULT)
 *              LORAWAN_REGION :                REGION_AU915
 *              LORAWAN_RGB :                   ACTIVE
 *              LORAWAN_UPLINKMODE :            UNCONFIRMED
 * LORAWAN_ADR – Turn ON or turn OFF ADR (Adaptive Data Rate);                   */
/* - - - - - - - - - - - - - - - - - - - - - - - - - - - - - - - - - - - - - - - */

#include "Arduino.h"
#include "LoRaWan_APP.h"

#include <Wire.h>
#include <Seeed_BME280.h>
#include <BH1750.h>
#include <TinyGPS++.h>
#include <softSerial.h>

// ======================================================
// CONFIGURAÇÕES DE HARDWARE
// ======================================================

#define AB01_GPS_RX_PIN GPIO5
#define AB01_GPS_TX_PIN GPIO4

// LED externo sugerido em GPIO1
#define STATUS_LED_PIN GPIO1

// Ordem no CubeCell softSerial: TX, RX
softSerial gpsSerial(AB01_GPS_TX_PIN, AB01_GPS_RX_PIN);

// ======================================================
// CONFIGURAÇÕES LORA
// ======================================================

#define LORA_FREQUENCY        915000000

#define LORA_BANDWIDTH        0       // 0 = 125 kHz
#define LORA_SPREADING_FACTOR 7
#define LORA_CODINGRATE       1       // 1 = 4/5
#define LORA_PREAMBLE_LENGTH  8
#define LORA_SYMBOL_TIMEOUT   0
#define LORA_FIX_LENGTH_PAYLOAD_ON false
#define LORA_IQ_INVERSION_ON  false

#define SEND_INTERVAL_MS      10000UL
#define RX_COMMAND_WINDOW_MS  2500

int8_t txPower = 14;

const int8_t TX_POWER_MIN = 14;
const int8_t TX_POWER_MAX = 20;

const uint16_t	  GPS_BAUDRATE = 9600,
				          SERIAL_BAUDRATE = 9600;
// TAXA DE COMUNICACAO DEVE SER A MESMA DA SERIAL EMULADA COM A SERIAL EM HARDWARE PARA NAO GERAR CONFLITO DE COMUNICACAO.				

// ======================================================
// OBJETOS
// ======================================================

BME280 bme280;
BH1750 lightMeter;
TinyGPSPlus gps;

static RadioEvents_t RadioEvents;

// ======================================================
// VARIÁVEIS DO LOGGER
// ======================================================

String d_chipid = "";
String d_boardName = "CubeCell_AB01_V2";

uint8_t d_count = 0;

float d_l_amb = 0.0;
float d_t_amb = 0.0;
float d_p_amb = 0.0;
float d_u_amb = 0.0;

uint16_t d_mvbat = 0;

double d_gps_lat = 0.0;
double d_gps_long = 0.0;
String d_gps_date = "";
String d_gps_time = "";
float d_gps_altitude = 0.0;
uint8_t d_gps_satellites = 0;

unsigned long lastSendTime = 0;

// ======================================================
// LED NON-BLOCKING
// ======================================================

enum LedMode {
  LED_SIGNAL_GOOD,
  LED_SIGNAL_LOW,
  LED_SIGNAL_CRITICAL,
  LED_POWER_CHANGED
};

LedMode ledMode = LED_SIGNAL_GOOD;

unsigned long lastLedMillis = 0;
bool ledState = false;
uint8_t burstCount = 0;

void updateStatusLed() {
  unsigned long now = millis();
  unsigned long interval = 5000;

  switch (ledMode) {
    case LED_SIGNAL_GOOD:
      interval = 5000;
      break;

    case LED_SIGNAL_LOW:
      interval = 500;
      break;

    case LED_SIGNAL_CRITICAL:
      interval = 150;
      break;

    case LED_POWER_CHANGED:
      interval = 120;
      break;
  }

  if (now - lastLedMillis >= interval) {
    lastLedMillis = now;

    ledState = !ledState;
    digitalWrite(STATUS_LED_PIN, ledState ? HIGH : LOW);

    if (ledMode == LED_POWER_CHANGED && ledState == LOW) {
      burstCount++;

      if (burstCount >= 3) {
        burstCount = 0;
        ledMode = LED_SIGNAL_LOW;
      }
    }
  }
}

// ======================================================
// FUNÇÕES AUXILIARES
// ======================================================

String getCubeCellIDString() {
  uint64_t id = getID();

  char buffer[17];

  snprintf(
    buffer,
    sizeof(buffer),
    "%08lX%08lX",
    (unsigned long)(id >> 32),
    (unsigned long)(id & 0xFFFFFFFF)
  );

  return String(buffer);
}

uint16_t readBatteryMillivolts() {
  return getBatteryVoltage();
}

String getValueFromPayload(String payload, String key) {
  String searchKey = key + "=";

  int startIndex = payload.indexOf(searchKey);

  if (startIndex < 0) {
    return "";
  }

  startIndex += searchKey.length();

  int endIndex = payload.indexOf("&", startIndex);

  if (endIndex < 0) {
    endIndex = payload.length();
  }

  return payload.substring(startIndex, endIndex);
}

// ======================================================
// GPS
// ======================================================

void updateGPS(unsigned long durationMs) {
  unsigned long start = millis();

  while (millis() - start < durationMs) {
    while (gpsSerial.available()) {
      gps.encode(gpsSerial.read());
    }

    updateStatusLed();
    Radio.IrqProcess();
  }

  if (gps.location.isValid()) {
    d_gps_lat = gps.location.lat();
    d_gps_long = gps.location.lng();
  }

  if (gps.date.isValid()) {
    char dateBuffer[11];

    snprintf(
      dateBuffer,
      sizeof(dateBuffer),
      "%04d%02d%02d",
      gps.date.year(),
      gps.date.month(),
      gps.date.day()
    );

    d_gps_date = String(dateBuffer);
  }

  if (gps.time.isValid()) {
    char timeBuffer[7];

    snprintf(
      timeBuffer,
      sizeof(timeBuffer),
      "%02d%02d%02d",
      gps.time.hour(),
      gps.time.minute(),
      gps.time.second()
    );

    d_gps_time = String(timeBuffer);
  }

  if (gps.altitude.isValid()) {
    d_gps_altitude = gps.altitude.meters();
  }

  if (gps.satellites.isValid()) {
    d_gps_satellites = gps.satellites.value();
  }
}

// ======================================================
// SENSORES
// ======================================================

void readSensors() {
  d_t_amb = bme280.getTemperature();

  // Seeed_BME280 normalmente retorna pressão em Pa.
  // Converter Pa para hPa:
  d_p_amb = bme280.getPressure() / 100.0;

  d_u_amb = bme280.getHumidity();

  d_l_amb = lightMeter.readLightLevel();

  d_mvbat = readBatteryMillivolts();

  updateGPS(1000);
}

// ======================================================
// PAYLOAD COMPACTO LORA
// ======================================================
//
// ID = d_chipid
// BN = d_boardName
// C  = d_count
// L  = luminosidade
// T  = temperatura
// P  = pressão
// U  = umidade
// B  = bateria mV
// LA = latitude
// LO = longitude
// GD = data GPS
// GT = hora GPS
// GA = altitude
// GS = satélites
// TX = potência atual
//
// Exemplo:
// ID=...;BN=...;C=1;L=200.0;T=25.0;P=1013.2;U=60.0;B=4100;LA=...;LO=...;GD=...;GT=...;GA=...;GS=...;TX=14
// ======================================================

String buildPayload() {
  String payload = "";

  payload += "ID=" + d_chipid;
  payload += ";BN=" + d_boardName;
  payload += ";C=" + String(d_count);

  payload += ";L=" + String(d_l_amb, 2);
  payload += ";T=" + String(d_t_amb, 2);
  payload += ";P=" + String(d_p_amb, 2);
  payload += ";U=" + String(d_u_amb, 2);

  payload += ";B=" + String(d_mvbat);

  payload += ";LA=" + String(d_gps_lat, 6);
  payload += ";LO=" + String(d_gps_long, 6);
  payload += ";GD=" + d_gps_date;
  payload += ";GT=" + d_gps_time;
  payload += ";GA=" + String(d_gps_altitude, 2);
  payload += ";GS=" + String(d_gps_satellites);

  payload += ";TX=" + String(txPower);

  return payload;
}

// ======================================================
// CONFIGURAÇÃO E AJUSTE DE POTÊNCIA TX
// ======================================================

void configureTxPower() {
  Radio.SetTxConfig(
    MODEM_LORA,
    txPower,
    0,
    LORA_BANDWIDTH,
    LORA_SPREADING_FACTOR,
    LORA_CODINGRATE,
    LORA_PREAMBLE_LENGTH,
    LORA_FIX_LENGTH_PAYLOAD_ON,
    true,
    0,
    0,
    LORA_IQ_INVERSION_ON,
    3000
  );
}

void applyTxPower(int8_t newPower) {
  if (newPower < TX_POWER_MIN) {
    newPower = TX_POWER_MIN;
  }

  if (newPower > TX_POWER_MAX) {
    newPower = TX_POWER_MAX;
  }

  if (newPower == txPower) {
    return;
  }

  txPower = newPower;

  configureTxPower();

  Serial.print("Nova potencia TX aplicada: ");
  Serial.print(txPower);
  Serial.println(" dBm");

  ledMode = LED_POWER_CHANGED;
  burstCount = 0;
}

// ======================================================
// CALLBACKS LORA
// ======================================================

void OnTxDone(void) {
  Serial.println("LoRa TX concluido. Aguardando comando do Gateway...");

  Radio.Sleep();
  Radio.Rx(RX_COMMAND_WINDOW_MS);
}

void OnTxTimeout(void) {
  Serial.println("LoRa TX timeout.");
  Radio.Sleep();
}

void OnRxDone(uint8_t *payload, uint16_t size, int16_t rssi, int8_t snr) {
  char buffer[160];

  if (size >= sizeof(buffer)) {
    size = sizeof(buffer) - 1;
  }

  memcpy(buffer, payload, size);
  buffer[size] = '\0';

  String command = String(buffer);

  Serial.print("Comando recebido do Gateway: ");
  Serial.println(command);

  String txpStr = getValueFromPayload(command, "CMD_TXP");

  if (txpStr.length() > 0) {
    int requestedPower = txpStr.toInt();
    applyTxPower(requestedPower);
  }

  String ledStr = getValueFromPayload(command, "LED");

  if (ledStr == "GOOD") {
    ledMode = LED_SIGNAL_GOOD;
  } else if (ledStr == "LOW") {
    ledMode = LED_SIGNAL_LOW;
  } else if (ledStr == "CRITICAL") {
    ledMode = LED_SIGNAL_CRITICAL;
  }

  Radio.Sleep();
}

void OnRxTimeout(void) {
  Serial.println("Janela RX finalizada sem comando.");
  Radio.Sleep();
}

void OnRxError(void) {
  Serial.println("Erro RX no CubeCell.");
  Radio.Sleep();
}

// ======================================================
// SETUP
// ======================================================

void setup() {
  // IMPORTANTE para CubeCell
  boardInitMcu();

  Serial.begin(SERIAL_BAUDRATE);
  delay(1000);

  Serial.println();
  Serial.println("LoggerLora Range Node");
  Serial.println("CubeCell AB01 V2");

  pinMode(STATUS_LED_PIN, OUTPUT);
  digitalWrite(STATUS_LED_PIN, LOW);

  d_chipid = getCubeCellIDString();

  Serial.print("CubeCell ID: ");
  Serial.println(d_chipid);

  Wire.begin();

  if (!bme280.init()) {
    Serial.println("ERRO: BME280 nao encontrado!");
  } else {
    Serial.println("BME280 OK.");
  }

  if (lightMeter.begin(BH1750::CONTINUOUS_HIGH_RES_MODE)) {
    Serial.println("BH1750 OK.");
  } else {
    Serial.println("ERRO: BH1750 nao encontrado!");
  }

  gpsSerial.begin(GPS_BAUDRATE);
  Serial.println("GPS softSerial iniciado em 9600 bps.");

  RadioEvents.TxDone = OnTxDone;
  RadioEvents.TxTimeout = OnTxTimeout;
  RadioEvents.RxDone = OnRxDone;
  RadioEvents.RxTimeout = OnRxTimeout;
  RadioEvents.RxError = OnRxError;

  Radio.Init(&RadioEvents);
  Radio.SetChannel(LORA_FREQUENCY);

  configureTxPower();

  Serial.print("Potencia TX inicial: ");
  Serial.print(txPower);
  Serial.println(" dBm");

  Serial.println("Sistema pronto.");
}

// ======================================================
// LOOP
// ======================================================

void loop() {
  Radio.IrqProcess();
  updateStatusLed();

  if (millis() - lastSendTime >= SEND_INTERVAL_MS) {
    lastSendTime = millis();

    readSensors();

    String payload = buildPayload();

    Serial.println();
    Serial.println("Enviando payload LoRa:");
    Serial.println(payload);

    Radio.Send((uint8_t *)payload.c_str(), payload.length());

    d_count++;
  }
}